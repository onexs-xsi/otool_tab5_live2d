## sdkconfig.defaults
```kconfig
# ESP32-P4 / M5Stack Tab5 最小配置
# 参考 tab5_breath_control_tool 的 sdkconfig.defaults 裁剪而来

# target
CONFIG_IDF_TARGET="esp32p4"

# flash
CONFIG_BOOTLOADER_FLASH_DC_AWARE=y
CONFIG_ESPTOOLPY_FLASHMODE_QIO=y
CONFIG_ESPTOOLPY_FLASHFREQ_120M=y
CONFIG_ESPTOOLPY_FLASHSIZE_16MB=y
CONFIG_SPI_FLASH_HPM_ENA=y

# bootloader（HPM + 120MHz 下默认配置会超过 0x6000 限制，压缩体积）
CONFIG_BOOTLOADER_COMPILER_OPTIMIZATION_SIZE=y
CONFIG_BOOTLOADER_LOG_LEVEL_WARN=y

# CPU / FreeRTOS
CONFIG_ESP_DEFAULT_CPU_FREQ_MHZ_400=y
CONFIG_ESP_DEFAULT_CPU_FREQ_MHZ=400
CONFIG_FREERTOS_HZ=1000

# PSRAM（LVGL 绘图缓冲使用）
CONFIG_SPIRAM=y
CONFIG_SPIRAM_SPEED_250M=y

# LVGL
CONFIG_LV_USE_CLIB_MALLOC=y
CONFIG_LV_DEF_REFR_PERIOD=16
CONFIG_LV_OS_FREERTOS=y
CONFIG_LV_USE_FREERTOS_TASK_NOTIFY=y
CONFIG_LV_DRAW_SW_DRAW_UNIT_CNT=2
CONFIG_LV_DRAW_THREAD_STACK_SIZE=8192
CONFIG_LV_DRAW_THREAD_PRIO=3
CONFIG_LV_ASSERT_HANDLER_INCLUDE="lv_assert_override.h"
CONFIG_LV_FONT_MONTSERRAT_24=y
CONFIG_LV_FONT_MONTSERRAT_36=y
# 中文字体改用 main/fonts/noto_cn_fonts 的二进制字体（lv_binfont_create_from_buffer，
# CMake EMBED_FILES 嵌入），取消 LVGL 内置 CJK 字体以减小固件体积
# 24px 中文字库的位图数据超过 1 MiB；必须使用 32 位 bitmap_index，
# 否则默认 20 位索引会回绕并把部分汉字解析成其他字形。
CONFIG_LV_FONT_FMT_TXT_LARGE=y
CONFIG_LV_USE_FS_MEMFS=y
# CONFIG_LV_FONT_SOURCE_HAN_SANS_SC_16_CJK is not set

# 其他
CONFIG_IDF_EXPERIMENTAL_FEATURES=y

# White-screen hello onexs build.
# Custom partition table and PERF optimization are kept for compatibility.
CONFIG_PARTITION_TABLE_CUSTOM=y
CONFIG_PARTITION_TABLE_CUSTOM_FILENAME="partitions.csv"
CONFIG_COMPILER_OPTIMIZATION_PERF=y
CONFIG_ESP_MAIN_TASK_STACK_SIZE=16384

# Volcengine ASR returns more HTTP Upgrade headers than ESP-IDF's 1 KiB
# websocket transport default can hold. This is the transport handshake buffer,
# not esp_websocket_client's later frame buffer. Release it after the upgrade.
CONFIG_WS_BUFFER_SIZE=8192
CONFIG_WS_DYNAMIC_BUFFER=y

# 调试期关闭 brownout 检测（USB 供电瞬时电流导致误复位；量产固件应恢复检测）
CONFIG_ESP_BROWNOUT_DET=n

# ESP-Hosted（C6 协处理器，SDIO 4-bit，参考 c145_tab5_wifi_module_update_ui_project sdkconfig）
CONFIG_ESP_HOSTED_ENABLED=y
CONFIG_ESP_HOSTED_CP_TARGET_ESP32C6=y
CONFIG_ESP_HOSTED_PRIV_ENABLE_WIFI_OPTIONS=y
CONFIG_ESP_HOSTED_IDF_SLAVE_TARGET="esp32c6"
CONFIG_ESP_HOSTED_P4_DEV_BOARD_NONE=y
CONFIG_ESP_HOSTED_PRIV_SDIO_OPTION=y
CONFIG_ESP_HOSTED_PRIV_SPI_HD_OPTION=y
CONFIG_ESP_HOSTED_SDIO_HOST_INTERFACE=y
CONFIG_ESP_HOSTED_SDIO_RESET_ACTIVE_HIGH=y
CONFIG_ESP_HOSTED_SDIO_OPTIMIZATION_RX_STREAMING_MODE=y
CONFIG_ESP_HOSTED_SDIO_SLOT_1=y
CONFIG_ESP_HOSTED_SDIO_SLOT=1
CONFIG_ESP_HOSTED_SDIO_4_BIT_BUS=y
CONFIG_ESP_HOSTED_SDIO_BUS_WIDTH=4
CONFIG_ESP_HOSTED_SDIO_CLOCK_FREQ_KHZ=40000
CONFIG_ESP_HOSTED_PRIV_SDIO_PIN_CMD_SLOT_1=13
CONFIG_ESP_HOSTED_PRIV_SDIO_PIN_CLK_SLOT_1=12
CONFIG_ESP_HOSTED_PRIV_SDIO_PIN_D0_SLOT_1=11
CONFIG_ESP_HOSTED_PRIV_SDIO_PIN_D1_4BIT_BUS_SLOT_1=10
CONFIG_ESP_HOSTED_PRIV_SDIO_PIN_D2_4BIT_BUS_SLOT_1=9
CONFIG_ESP_HOSTED_PRIV_SDIO_PIN_D3_4BIT_BUS_SLOT_1=8
CONFIG_ESP_HOSTED_SDIO_GPIO_RESET_SLAVE=15
CONFIG_ESP_HOSTED_SDIO_PIN_CMD=13
CONFIG_ESP_HOSTED_SDIO_PIN_CLK=12
CONFIG_ESP_HOSTED_SDIO_PIN_D0=11
CONFIG_ESP_HOSTED_SDIO_PRIV_PIN_D1_4BIT_BUS=10
CONFIG_ESP_HOSTED_SDIO_PIN_D2=9
CONFIG_ESP_HOSTED_SDIO_PIN_D3=8
CONFIG_ESP_HOSTED_SDIO_PIN_D1=10
CONFIG_ESP_HOSTED_SDIO_TX_Q_SIZE=20
CONFIG_ESP_HOSTED_SDIO_RX_Q_SIZE=20
CONFIG_ESP_HOSTED_SDIO_RESET_DELAY_MS=1500
CONFIG_ESP_HOSTED_SLAVE_RESET_ON_EVERY_HOST_BOOTUP=y
CONFIG_ESP_HOSTED_GPIO_SLAVE_RESET_SLAVE=15
CONFIG_ESP_HOSTED_RPC_TASK_STACK=4096
CONFIG_ESP_HOSTED_DFLT_TASK_STACK=3072
CONFIG_ESP_HOSTED_TRANSPORT_RESTART_ON_FAILURE=y
CONFIG_ESP_HOSTED_USE_MEMPOOL=y
CONFIG_ESP_HOSTED_MAX_SIMULTANEOUS_SYNC_RPC_REQUESTS=5
CONFIG_ESP_HOSTED_MAX_SIMULTANEOUS_ASYNC_RPC_REQUESTS=5
CONFIG_ESP_HOSTED_HOST_TO_ESP_WIFI_DATA_THROTTLE=y
CONFIG_ESP_HOSTED_PRIV_WIFI_TX_SDIO_HIGH_THRESHOLD=80
CONFIG_ESP_HOSTED_TO_WIFI_DATA_THROTTLE_HIGH_THRESHOLD=80
CONFIG_ESP_HOSTED_TO_WIFI_DATA_THROTTLE_LOW_THRESHOLD=60
CONFIG_ESP_HOSTED_ENABLE_PEER_DATA_TRANSFER=y
CONFIG_ESP_HOSTED_MAX_CUSTOM_MSG_HANDLERS=3
CONFIG_ESP_WIFI_REMOTE_LIBRARY_HOSTED=y

# Console: 主通道改 USB-Serial-JTAG（命令行交互）
CONFIG_ESP_CONSOLE_USB_SERIAL_JTAG=y
CONFIG_LV_FS_MEMFS_LETTER=77

# LLM/Agent worker 栈（真机实测 high-water mark：agent 余量曾仅 1.2KB）
CONFIG_OTOOL_LLM_LLM_TASK_STACK_SIZE=32768
CONFIG_OTOOL_LLM_AGENT_TASK_STACK_SIZE=40960
```

## sdkconfig.defaults.release
```kconfig
# Release 性能配置（可行性报告 §7.1）
#
# 用法：
#   idf.py -DSDKCONFIG_DEFAULTS="sdkconfig.defaults;sdkconfig.defaults.release" build
#
# 与 sdkconfig.defaults 叠加使用；正式基准必须用此配置，
# 并记录固件 SHA / 芯片 revision / CPU / PSRAM 频率 / 温度。

# 应用编译优化：PERF（默认构建为 DEBUG / -Og，不能用于推断渲染性能）
CONFIG_COMPILER_OPTIMIZATION_PERF=y

# 日志级别（基准时减少串口开销干扰）
CONFIG_LOG_DEFAULT_LEVEL_INFO=y
```
