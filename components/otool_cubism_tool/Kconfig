## components/otool_cubism_tool/Kconfig
```kconfig
menu "otool_cubism_tool"

    config OTOOL_CUBISM_ENABLE_CLIP_PLAYER
        bool "Enable clip player mode (route D)"
        default y
        help
            Pre-rendered clip playback with interaction state machine.
            Safe-net / fallback for the REALTIME route (feasibility report §8).

    config OTOOL_CUBISM_ENABLE_STREAM_CLIENT
        bool "Enable stream client mode (route C)"
        default n
        help
            Host-rendered JPEG frame streaming (implementation pending S2b).

    config OTOOL_CUBISM_ENABLE_REALTIME
        bool "Enable realtime mode (self Core)"
        default n
        help
            On-device realtime rendering with the in-component self moc3/Core
            runtime. Build gate removed (2026-08-21): this option compiles
            now; core/renderer sources are still under development and are
            added to the build as they land.

    choice OTOOL_CUBISM_CORE_BACKEND
        prompt "Core backend"
        default OTOOL_CUBISM_CORE_BACKEND_NONE
        help
            REALTIME requires SELF. NONE means clip/stream only.
            (OFFICIAL/PURISM history was retired with the self-Core decision.)

        config OTOOL_CUBISM_CORE_BACKEND_NONE
            bool "None (clip/stream only)"

        config OTOOL_CUBISM_CORE_BACKEND_SELF
            bool "SELF (in-component ot_core_* runtime)"
    endchoice

    config OTOOL_CUBISM_MOC_PROFILE_V5
        bool "moc3 profile: version byte 5"
        default y
        help
            The only releasable model profile for the first version.
            Packages must declare a matching profile; mismatches are rejected
            before any large allocation.

    config OTOOL_CUBISM_ANIMATION_BACKEND_SELF
        bool "Animation backend: SELF (in-component, self-authored)"
        default y
        help
            Only animation backend. Motion/expression/pose/physics are all
            self-authored implementations (self-authored-code rule: no third
            party code or binaries may enter the component).

    config OTOOL_CUBISM_ENABLE_V6_OFFSCREEN
        bool "Enable moc3 v6 offscreen / extended blend (5.3+)"
        default n
        help
            Not implemented yet; enabling currently has no effect
            (build no longer fails). Needs its own format/behavior gates.

    choice OTOOL_CUBISM_RENDER_SIZE
        prompt "Realtime render size"
        default OTOOL_CUBISM_RENDER_SIZE_640X360
        help
            Scene buffer resolution; PPA scales it to the physical panel.

        config OTOOL_CUBISM_RENDER_SIZE_640X360
            bool "640x360 (2x upscale)"

        config OTOOL_CUBISM_RENDER_SIZE_512X288
            bool "512x288 (2.5x upscale)"

        config OTOOL_CUBISM_RENDER_SIZE_320X180
            bool "320x180 (4x upscale)"
    endchoice

    config OTOOL_CUBISM_RASTER_WORKERS
        int "Raster worker count"
        range 1 2
        default 1
        help
            Tile raster workers for the realtime renderer; decided by B3/B6.

    config OTOOL_CUBISM_METRICS
        bool "Collect runtime metrics"
        default y
        help
            Heap/frame metrics. Publish builds may keep the low-cost counters.

endmenu
```

## components/otool_llm_sdk/Kconfig
```kconfig
menu "otool_llm_sdk"

config OTOOL_LLM_MAX_REQUEST_BYTES
    int "Maximum serialized JSON request body size (bytes)"
    default 32768
    range 1024 262144
    help
        Hard cap for the request body built by cJSON. Exceeding it returns
        OTOOL_LLM_ERR_REQUEST_TOO_LARGE; there is no silent truncation.

config OTOOL_LLM_MAX_REQUEST_MESSAGES
    int "Maximum messages accepted by one text request"
    default 32
    range 1 256
    help
        Bounds the message array allocated by request_create(). Agent-managed
        Chat transcripts have the separate, usually smaller Agent limit below.

config OTOOL_LLM_MAX_BASE_URL_BYTES
    int "Maximum provider base URL size (bytes)"
    default 512
    range 64 2048

config OTOOL_LLM_MAX_ENDPOINT_PATH_BYTES
    int "Maximum provider endpoint path size (bytes)"
    default 256
    range 16 1024

config OTOOL_LLM_MAX_API_KEY_BYTES
    int "Maximum runtime API key size (bytes)"
    default 896
    range 64 1000
    help
        Keeps the complete Bearer authorization value within the SDK's bounded
        header buffer. The key must still be injected at runtime.

config OTOOL_LLM_MAX_SSE_EVENT_BYTES
    int "Maximum merged SSE event data size (bytes)"
    default 16384
    range 512 131072
    help
        Hard cap for one merged SSE data payload (multiple data: lines joined
        with newline) and for any single SSE line. Exceeding it returns
        OTOOL_LLM_ERR_EVENT_TOO_LARGE.

config OTOOL_LLM_MAX_ERROR_BODY_BYTES
    int "Maximum non-2xx error body size (bytes)"
    default 4096
    range 256 32768
    help
        Bounded error body captured for the provider error parser. If the body
        is larger, the prefix is kept and a warning is logged.

config OTOOL_LLM_HTTP_RX_BUFFER_BYTES
    int "HTTP receive chunk buffer size (bytes)"
    default 2048
    range 256 16384
    help
        esp_http_client receive buffer size. Network chunks are fed to the SSE
        parser at arbitrary boundaries.

config OTOOL_LLM_CONNECT_TIMEOUT_MS
    int "Default connect timeout (ms)"
    default 15000
    range 1000 300000
    help
        Default connect timeout used when otool_llm_client_config_t leaves
        connect_timeout_ms <= 0.

config OTOOL_LLM_READ_TIMEOUT_MS
    int "Default stream read timeout (ms)"
    default 60000
    range 1000 600000
    help
        Default read timeout between stream chunks, used when
        otool_llm_client_config_t leaves read_timeout_ms <= 0.

config OTOOL_LLM_ALLOW_INSECURE_HTTP
    bool "Allow plain HTTP (insecure, local testing only)"
    default n
    help
        When disabled, client base URLs must start with https:// and TLS with
        the certificate bundle is enforced. Enable only for local test servers.

config OTOOL_LLM_MAX_TOOLS
    int "Maximum tools per request"
    default 8
    range 1 32
    help
        Upper bound of tool definitions accepted per request (and per registry later).

config OTOOL_LLM_MAX_TOOL_NAME_BYTES
    int "Maximum tool name size (bytes)"
    default 64
    range 16 64
    help
        Maximum bytes before the trailing NUL. Names are limited to ASCII
        letters, digits and underscore.

config OTOOL_LLM_MAX_TOOL_DESCRIPTION_BYTES
    int "Maximum tool description size (bytes)"
    default 512
    range 64 2048
    help
        Registration rejects longer model-facing descriptions.

config OTOOL_LLM_MAX_PENDING_TOOL_CALLS
    int "Maximum pending tool calls per turn"
    default 2
    range 1 8
    help
        Defensive cap for concurrently streaming function calls in one turn.

config OTOOL_LLM_MAX_TOOL_ARGUMENT_BYTES
    int "Maximum tool arguments size (bytes)"
    default 4096
    range 512 32768
    help
        Hard cap for one accumulated function_call arguments JSON.

config OTOOL_LLM_MAX_TOOL_OUTPUT_BYTES
    int "Maximum tool output size (bytes)"
    default 4096
    range 512 32768
    help
        Hard cap for one tool result returned to the model.

config OTOOL_LLM_MAX_TOOL_SCHEMA_BYTES
    int "Maximum JSON schema size per tool (bytes)"
    default 2048
    range 256 16384
    help
        Registration rejects a tool whose parameter schema exceeds this cap.

config OTOOL_LLM_MAX_TOTAL_TOOL_SCHEMA_BYTES
    int "Maximum aggregate tool schema size (bytes)"
    default 8192
    range 1024 65536
    help
        Aggregate schema byte budget for one sealed registry.

config OTOOL_LLM_MAX_AGENT_TURNS
    int "Default maximum model turns per agent run"
    default 6
    range 1 32

config OTOOL_LLM_MAX_AGENT_TOOL_CALLS
    int "Default maximum tool calls per agent run"
    default 8
    range 1 64

config OTOOL_LLM_MAX_AGENT_MESSAGES
    int "Maximum messages in a local Chat transcript"
    default 24
    range 4 128
    help
        The Chat state mode returns OTOOL_LLM_ERR_CONTEXT_FULL instead of
        silently evicting messages when this count is exhausted.

config OTOOL_LLM_MAX_AGENT_CONTEXT_BYTES
    int "Maximum owned local transcript bytes"
    default 32768
    range 4096 262144
    help
        Includes message text, tool call ids/names/arguments and local metadata.

config OTOOL_LLM_DEFAULT_AGENT_TIMEOUT_MS
    int "Default whole-agent-run timeout (ms)"
    default 120000
    range 1000 600000

config OTOOL_LLM_DEFAULT_TOOL_TIMEOUT_MS
    int "Default cooperative tool timeout (ms)"
    default 15000
    range 100 300000

endmenu
```

## components/otool_llm_sdk/test_apps/transport_test/Kconfig
```kconfig
menu "otool_llm_sdk transport test"

config OTOOL_LLM_TEST_SERVER_HOST
    string "Local SSE test server host"
    default "localhost"
    help
        Host of local_sse_server.py. Use "localhost" on the linux target;
        use the PC's LAN IP when running on a device.

config OTOOL_LLM_TEST_SERVER_PORT
    int "Local SSE test server port"
    default 18080
    range 1 65535

endmenu
```

## components/otool_speech_sdk/Kconfig
```kconfig
menu "otool_speech_sdk"

config OTOOL_SPEECH_ASR_PACKET_MS
    int "ASR packet duration (ms)"
    default 200
    range 100 200
    help
        Volcengine recommends 100-200 ms packets and documents 200 ms as
        optimal for the optimized bidirectional endpoint.

config OTOOL_SPEECH_ASR_MAX_RESPONSE_BYTES
    int "Maximum assembled ASR WebSocket message (bytes)"
    default 16384
    range 2048 65536

config OTOOL_SPEECH_ASR_MAX_TRANSCRIPT_BYTES
    int "Maximum final ASR transcript (bytes)"
    default 1024
    range 256 8192

config OTOOL_SPEECH_ASR_FILE_MAX_RESPONSE_BYTES
    int "Maximum recording-file ASR query response (bytes)"
    default 32768
    range 4096 131072
    help
        Maximum JSON response retained while polling recording-file ASR. The
        full result can include utterance metadata even though the public API
        returns only result.text to the caller.

config OTOOL_SPEECH_WS_TASK_STACK_SIZE
    int "Speech WebSocket task stack size (bytes)"
    default 8192
    range 4096 32768

config OTOOL_SPEECH_WS_BUFFER_BYTES
    int "Speech WebSocket receive chunk size (bytes)"
    default 2048
    range 512 16384

config OTOOL_SPEECH_TTS_STREAM_BUFFER_BYTES
    int "Maximum assembled TTS WebSocket message (bytes)"
    default 32768
    range 8192 65536
    help
        Must fit one bidirectional TTS PCM audio frame plus its protocol
        envelope. 32 KiB leaves headroom for current 16 kHz PCM chunks.

endmenu
```

## main/Kconfig
```kconfig
menu "otool_tab5_live2d app"

config OTOOL_WIFI_SSID
    string "Wi-Fi SSID"
    default ""
    help
      Configure the deployment Wi-Fi SSID in the local sdkconfig/menuconfig.
      An empty value disables Wi-Fi without aborting application startup.
      Do not place a real value in sdkconfig.defaults or another tracked file.

config OTOOL_WIFI_PASSWORD
    string "Wi-Fi password"
    default ""
    help
      Configure the deployment Wi-Fi password in the local sdkconfig/menuconfig.
      An empty value is accepted for an open network. Do not place a real value
      in sdkconfig.defaults or another tracked file.

config OTOOL_WIFI_MAX_RETRY
    int "Wi-Fi connect max retries"
    default 10
    range 1 100

config OTOOL_LLM_API_KEY
    string "Volcengine Ark API key"
    default ""
    help
      Configure the deployment API key in the local sdkconfig/menuconfig.
      An empty value disables the LLM and Agent workers without aborting the
      application. Do not place a real value in a tracked defaults file.

config OTOOL_LLM_MODEL
    string "Doubao model id"
    default "doubao-seed-2-1-turbo-260628"

config OTOOL_SPEECH_API_KEY
    string "Volcengine Speech API key"
    default ""
    help
      Configure the API Key created in the Volcengine Speech console. This is
      intentionally separate from the Ark LLM key. An empty value disables
      cloud ASR/TTS without aborting startup. Never place a real value in a
      tracked defaults file.

config OTOOL_SPEECH_ASR_RESOURCE_ID
    string "Volcengine ASR resource id"
    default "volc.seedasr.sauc.duration"
    help
      Streaming ASR 2.0 hourly resource id from the new Speech console.
      Use volc.seedasr.sauc.concurrent only for a concurrency entitlement.

config OTOOL_SPEECH_TTS_RESOURCE_ID
    string "Volcengine TTS resource id"
    default "seed-tts-2.0"
    help
      Standard Speech Synthesis 2.0 resource id from the new Speech console.

config OTOOL_SPEECH_TTS_SPEAKER
    string "Volcengine TTS speaker id"
    default ""
    help
      Voice id from Speech console > Voice Library. An empty value leaves ASR
      available but skips response playback safely.

config OTOOL_SPEECH_MIC_CHANNEL
    int "ES7210 microphone channel used for ASR"
    default 0
    range 0 3

config OTOOL_SPEECH_ASR_FINISH_TIMEOUT_MS
    int "ASR final result timeout (ms)"
    default 15000
    range 1000 60000

config OTOOL_SPEECH_TTS_TIMEOUT_MS
    int "TTS stream timeout (ms)"
    default 60000
    range 5000 180000

config OTOOL_SPEECH_APP_TASK_STACK_SIZE
    int "Voice interaction task stack size (bytes)"
    default 16384
    range 8192 32768

config OTOOL_SPEECH_PROBE_TASK_STACK_SIZE
    int "Speech API probe task stack size (bytes)"
    default 16384
    range 8192 32768

config OTOOL_SPEECH_PROBE_MAX_PCM_BYTES
    int "Speech TTS-to-ASR probe PCM limit (bytes)"
    default 524288
    range 65536 1048576
    help
      Maximum PSRAM allocation for the console speech-loopback command. The
      probe never sends this data to the physical speaker.

config OTOOL_LLM_LLM_TASK_STACK_SIZE
    int "LLM worker task stack size (bytes)"
    default 32768
    range 8192 65536

config OTOOL_LLM_AGENT_TASK_STACK_SIZE
    int "Agent worker task stack size (bytes)"
    default 40960
    range 8192 65536

config OTOOL_LLM_UI_REFRESH_MS
    int "LLM UI refresh period (ms)"
    default 100
    range 20 1000

endmenu
```
